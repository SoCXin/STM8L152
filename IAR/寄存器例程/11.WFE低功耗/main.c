/*******************************************************************************
*******************************蓝旗嵌入式系统***********************************
*************************http://lenchimcu.taobao.com****************************
*******************************************************************************/

#include"iostm8l151k4.h"
#define LED_PORT PA_ODR_ODR6
/*******************************************************************************
****入口参数：ms，延时的数目
****出口参数：无
****函数备注：延时函数
****版权信息：蓝旗嵌入式系统
*******************************************************************************/
void delay(unsigned int ms)
{
       unsigned char i;
       while(ms!=0)
       {
              for(i=0;i<250;i++)
              {}
              for(i=0;i<75;i++)
              {}
              ms--;
       }
}
/*******************************************************************************
****入口参数：无
****出口参数：无
****函数备注：GPIO配置，配置PA6输出
****版权信息：蓝旗嵌入式系统
*******************************************************************************/
void Init_GPIO(void)
{
       PA_DDR_DDR6 = 1;
       PA_CR1_C16 = 1; 
       PA_CR2_C26 = 0;
}
/*******************************************************************************
****入口参数：无
****出口参数：无
****函数备注：中断初始化，PB4映射到外部中断4，PB4端口带上拉输入，下降沿触发
****版权信息：蓝旗嵌入式系统
*******************************************************************************/
void Init_ExInt(void)
{
    CPU_CCR=0X28;  //等级3
    EXTI_CONF=0x00;//PB4->EXTI4
    EXTI_CR2=0x02;//下降沿触发
    PB_DDR_DDR4=0;//PB4输入
    PB_CR1_C14=1;//PB4上拉
    PB_CR2_C24=1;//PB4中断使能
}
/*******************************************************************************
****入口参数：无
****出口参数：无
****函数备注：低功耗模式的进入和唤醒，WFI、HALT低功耗模式
****版权信息：蓝旗嵌入式系统
*******************************************************************************/
int main( void )
{
    Init_GPIO();
    Init_ExInt(); //配置外部中断
    WFE_CR2=0x01; //配置外部中断4为WFE事件
    //asm("rim");//开中断，sim为关中断
    while(1)
    {
        asm("wfe");
        EXTI_SR1=0x10; //清除中断标志，WFE时不进入外部中断响应函数，但外部中断标志位还会有效
        LED_PORT^=1;   //翻转LED状态
        delay(500);
    }
    
}
/*******************************************************************************
****入口参数：无
****出口参数：无
****函数备注：外部中断4响应函数，下降沿触发
****版权信息：蓝旗嵌入式系统
*******************************************************************************/
#pragma vector= EXTI4_vector
__interrupt void EXTI4_IRQHandler(void)
{
   
    if(EXTI_SR1==0x10) //是否外部中断4触发
    {
        EXTI_SR1=0x10; //清除中断标志
        LED_PORT=0;   //点亮LED

    }
}
/*******************************************************************************
*******************************蓝旗嵌入式系统***********************************
*************************http://lenchimcu.taobao.com****************************
*******************************************************************************/