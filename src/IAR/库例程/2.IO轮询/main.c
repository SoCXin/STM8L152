/*******************************************************************************
*******************************蓝旗嵌入式系统***********************************
*************************http://lenchimcu.taobao.com****************************
********************************************************************************
****例程简介:STM8L151K4库例程工程Demo
*******************************************************************************/
#include "stm8l15x.h"
//定义LED与按键接口
#define LED_GPIO_PORT  GPIOA
#define LED_GPIO_PINS  GPIO_Pin_6
#define KEY_GPIO_PORT  GPIOB
#define KEY_GPIO_PINS  GPIO_Pin_4
/*******************************************************************************
****入口参数：无
****出口参数：无
****函数备注：延时函数
****版权信息：蓝旗嵌入式系统
*******************************************************************************/
void Delay(__IO uint16_t nCount)
{
    /* Decrement nCount value */
    while (nCount != 0)
    {
        nCount--;
    }
}

/*******************************************************************************
****入口参数：无
****出口参数：无
****函数备注：GPIO输入测试程序，PA6灌流方式连接LED，PB4连接独立按键，不断按压按键
              LED状态改变
****版权信息：蓝旗嵌入式系统
*******************************************************************************/
int main( void )
{
    GPIO_Init(LED_GPIO_PORT, LED_GPIO_PINS, GPIO_Mode_Out_PP_Low_Slow);//初始化LED，GPA6低速推挽输出
    GPIO_Init(KEY_GPIO_PORT, KEY_GPIO_PINS, GPIO_Mode_In_PU_No_IT);//初始化按键，GPB4上拉输入
    while(1)
    {
         if(GPIO_ReadInputDataBit(KEY_GPIO_PORT,KEY_GPIO_PINS)==0)//读GPB4输入状态
         {
             Delay(0x3FFF);  //软件防抖
             if(GPIO_ReadInputDataBit(KEY_GPIO_PORT,KEY_GPIO_PINS)==0)  //读GPB4输入状态
                GPIO_ToggleBits(LED_GPIO_PORT, LED_GPIO_PINS);//翻转GPA6输出状态
         }
    }
}

/*******************************************************************************
*******************************蓝旗嵌入式系统***********************************
*************************http://lenchimcu.taobao.com****************************
*******************************************************************************/
