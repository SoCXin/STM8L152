/*******************************************************************************
*******************************蓝旗嵌入式系统***********************************
*************************http://lenchimcu.taobao.com****************************
********************************************************************************
****例程简介:STM8L151K4库例程GPIO例程
*******************************************************************************/
#include "stm8l15x.h"
#include "1621.h"

unsigned char Ht1621Tab[]={0x00,0x00,0x00,0x00};
/*******************************************************************************
****函数名称:
****函数功能:延时函数
****版本:V1.0
****日期:14-2-2014
****入口参数:需要延时的数目
****出口参数:无
****说明:
********************************************************************************/
void Delay(uint16_t nCount)
{
  while (nCount != 0)
  {   
    nCount--;
  }
}


/*******************************************************************************
****入口参数：无
****出口参数：无
****函数备注：液晶显示程序，采用HT1621驱动芯片驱动段码液晶，将AD结果显示于液晶面板
              液晶与核心板的接口请见1621.H文件定义
****版权信息：蓝旗嵌入式系统
*******************************************************************************/
int main( void )
{
    u16 u16_adc1_value;   
    u16 VoltageValue;
    CLK_PeripheralClockConfig (CLK_Peripheral_ADC1,ENABLE);//开启ADC/USART时钟
    ADC_Init (ADC1,ADC_ConversionMode_Single,ADC_Resolution_12Bit,ADC_Prescaler_1);//单次转换，12位，1分频
    ADC_Cmd(ADC1,ENABLE);//使能ADC1
    ADC_ChannelCmd (ADC1,ADC_Channel_11,ENABLE);//使能ADC11通道
    
    Delay(100);           //延时一段时间 
    Ht1621_Init();        //上电初始化LCD 
    Delay(100);           //延时一段时间 
    Ht1621WrAllData(0,Ht1621Tab,16);// 清屏
    
    while (1)
    {
        Delay(5000);  
        Delay(5000); 
        Delay(5000); 
        Delay(5000); 
        ADC_SoftwareStartConv (ADC1);//使能软件转换
        while(!ADC_GetFlagStatus (ADC1,ADC_FLAG_EOC));//等待转换完毕
        ADC_ClearFlag (ADC1,ADC_FLAG_EOC);//清除相关标识
        Delay(5000);  
        Delay(5000); 
        Delay(5000); 
        Delay(5000); 
        u16_adc1_value=ADC_GetConversionValue (ADC1);//获取转换值
        VoltageValue=u16_adc1_value*3300UL/4095UL;//对转换值进行电压转换
        data_convertor(VoltageValue);//转换为显示值
        Display();//显示数值
        Display_lcd_dot();//显示小数点
        Delay(5000);  
        Delay(5000); 
        Delay(5000); 
        Delay(5000); 
    }

}

/*******************************************************************************
*******************************蓝旗嵌入式系统***********************************
*************************http://lenchimcu.taobao.com****************************
*******************************************************************************/
