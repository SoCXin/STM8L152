/*******************************************************************************
*******************************蓝旗嵌入式系统***********************************
*************************http://lenchimcu.taobao.com****************************
*******************************************************************************/

#include"iostm8l151k4.h"
unsigned char HexTable[]={'0','1','2','3','4','5','6','7','8','9','A','B','C','D','E','F'};
/*******************************************************************************
****入口参数：无
****出口参数：无
****函数备注：USART初始化函数
****版权信息：蓝旗嵌入式系统
*******************************************************************************/
void Init_USART1(void)
{
      CLK_PCKENR1 |= (1<<5);//开串口时钟
      PC_DDR |= (1<<3);     //TX引脚为输出
      PC_CR1 |= (1<<3);
      PC_CR2 |= (1<<3);
      //配置USART参数
      USART1_CR1=0x00;
      USART1_CR2=0x00;
      USART1_CR3=0x00;
      // 设置波特率，必须注意以下几点：
      // (1) 必须先写BRR2
      // (2) BRR1存放的是分频系数的第11位到第4位，
      // (3) BRR2存放的是分频系数的第15位到第12位，和第3位
      // 到第0位
      // 例如对于波特率位9600时，分频系数=2000000/9600=208
      // 对应的十六进制数为00D0，BBR1=0D,BBR2=00

      USART1_BRR2=0x00;
      USART1_BRR1=0x0d;

      USART1_CR2=0x2c;//允许接收，发送，开接收中断
}

/*******************************************************************************
****入口参数：需要发送的字符串
****出口参数：无
****函数备注：USART发送函数
****版权信息：蓝旗嵌入式系统
*******************************************************************************/
void USART1_sendstr(unsigned char *Str) 
{
        while(*Str!=0)
        {
                USART1_DR = *Str;
                Str++;
                while(!(USART1_SR&0x80));
        }
}
/*******************************************************************************
****入口参数：需要发送的数据
****出口参数：无
****函数备注：USART发送函数
****版权信息：蓝旗嵌入式系统
*******************************************************************************/
void USART1_sendchar(unsigned char c)
{
      while((USART1_SR & 0x80)==0x00);
      USART1_DR=c;
}
void USART1_sendhex(unsigned char dat)
{
      USART1_sendchar('0');
		
      USART1_sendchar('x');
		
      USART1_sendchar(HexTable[dat>>4]);
		
      USART1_sendchar(HexTable[dat&0x0f]);
		
      USART1_sendchar(' ');
}
/*******************************************************************************
****入口参数：无
****出口参数：无
****函数备注：AD初始化函数
****版权信息：蓝旗嵌入式系统
*******************************************************************************/
void Init_AD(void)
{
      CLK_PCKENR2|=(1<<0);
      ADC1_CR1|=0x01;//使能ADC，使用Sing mode
      ADC1_CR2=0x02; //使用MCU系统时钟频率作ADC的时钟；
                     //AD转换软启动；
                     //AD采样时间16个系统时钟；
}
/*******************************************************************************
****入口参数：无
****出口参数：无
****函数备注：AD采样光敏分压后的电压值，并通过UART发送给计算机
****版权信息：蓝旗嵌入式系统
*******************************************************************************/
int main( void )
{
      int i=0;  
      Init_USART1();
      Init_AD();
     
      while(1)
      {
          ADC1_CR1|=0x02;
          for(i=0;i<100;i++); // 延时一段时间，至少7uS，保证ADC 模块上电王城
          
          ADC1_SQR3 = 0X08;   //选择ADC通道
      
          while((ADC1_SR & 0x01)!=0x01); // 等待转换结束
          ADC1_SR &= (~(1<<0));
          USART1_sendhex(ADC1_DRH);
          USART1_sendhex(ADC1_DRL);
          USART1_sendstr("\r\n");
      }
}
/*******************************************************************************
*******************************蓝旗嵌入式系统***********************************
*************************http://lenchimcu.taobao.com****************************
*******************************************************************************/